## firmware/smartbuddy-esp32/main/sdkconfig.defaults
```kconfig
# SmartBuddy ESP-IDF sdkconfig defaults

# Partition table — custom CSV (1.75MB app partitions untuk muat BLE+IR+WiFi)
CONFIG_PARTITION_TABLE_CUSTOM=y
CONFIG_PARTITION_TABLE_CUSTOM_FILENAME="partitions.csv"
CONFIG_PARTITION_TABLE_OFFSET=0x8000

# FreeRTOS
CONFIG_FREERTOS_HZ=1000

# Log level
CONFIG_LOG_DEFAULT_LEVEL_INFO=y
CONFIG_LOG_MAXIMUM_LEVEL_VERBOSE=y

# WiFi
CONFIG_ESP_WIFI_STATIC_RX_BUFFER_NUM=10
CONFIG_ESP_WIFI_DYNAMIC_TX_BUFFER_NUM=32
CONFIG_ESP_WIFI_AMPDU_TX_ENABLED=y
CONFIG_ESP_WIFI_AMPDU_RX_ENABLED=y

# MQTT
CONFIG_MQTT_TRANSPORT_SSL=n
CONFIG_MQTT_TRANSPORT_WEBSOCKET=n

# Bluetooth — BLE only
CONFIG_BT_ENABLED=y
CONFIG_BT_BLE_ENABLED=y
CONFIG_BT_BLE_42_FEATURES_SUPPORTED=y
CONFIG_BT_BLUEDROID_ENABLED=y
CONFIG_BT_CLASSIC_ENABLED=n
CONFIG_BT_GATTS_ENABLE=y

# HTTP client
CONFIG_ESP_HTTP_CLIENT_ENABLE_HTTPS=n

# Heap size
CONFIG_ESP_MAIN_TASK_STACK_SIZE=8192

# NVS encryption disabled (simplicity)
CONFIG_NVS_ENCRYPTION=n

# Watchdog
CONFIG_ESP_TASK_WDT=y
CONFIG_ESP_TASK_WDT_PANIC=y
CONFIG_ESP_TASK_WDT_TIMEOUT_S=30

# OTA
CONFIG_OTA_ALLOW_HTTP=y

# SNTP
CONFIG_LWIP_SNTP_MAX_SERVERS=2

# RMT (IR)
CONFIG_RMT_ISR_IRAM_SAFE=y
```
